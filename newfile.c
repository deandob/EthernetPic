
#include <stddef.h>
#include <stdlib.h>
#include <stdio.h>
#include <string.h>
#include <math.h>
#include <ctype.h>
#include <stdint.h>
#include <stdbool.h>
#include <xc.h>

#define FOSC    (32000000ULL)
#define FCY     (FOSC/2)

#include <libpic30.h>


/////////////////////////////////////////////////////////////////////////
//
// I2C Routines
//

#define I2C1_SCL_TRIS	TRISBbits.TRISB8
#define I2C1_SDA_TRIS	TRISBbits.TRISB9
#define I2C1_SCL_LAT	LATBbits.LATB8
#define I2C1_SDA_LAT	LATBbits.LATB9

#define kI2C_100KHZ     (0x00)
#define kI2C_400KHZ     (0x02)


void i2c1Enable( uint8_t flags )
{
    // Calculate BGP from FCY
    // brg = ( FCY/FSCL - FCY/10000000) - 1
    uint32_t fscl = ( flags & kI2C_400KHZ ) ? 400000UL : 100000UL;
    uint16_t brg = ( ( FCY / fscl ) - ( FCY / 1000000 ) ) - 1;
    I2C1BRG = brg;

    // enable I2C module
    I2C1CONbits.I2CEN = 1;
}


void i2c1Disable()
{
    I2C1CONbits.I2CEN = 0;
}


static int16_t i2c1XferInt(
	uint8_t address,
	uint8_t* wdata, int wsize,
	uint8_t* rdata, int rsize )
{
    int16_t count = 0;
    bool hasWrite = ( wdata != NULL ) && ( wsize != 0 );
    bool hasRead = ( rdata != NULL ) && ( rsize != 0 );
    if ( ! ( hasWrite || hasRead ) ) return -1;

    // clear bus collision
    I2C1STATbits.BCL = 0;

    // generate start condition
    I2C1CONbits.SEN = 1;
    while ( 1 ) {
        if ( I2C1STATbits.BCL ) return -2;
        if ( ! I2C1CONbits.SEN ) break;
    }

    // Send 7-bit slave address and Read/Write flag
    I2C1TRN = ( address << 1 ) | ( hasWrite ? 0x00 : 0x01 );
    while ( 1 ) {
        if ( I2C1STATbits.BCL ) return -3;
        if ( ! I2C1STATbits.TRSTAT ) break;
    }

    if ( I2C1STATbits.ACKSTAT ) return -4;

    // Write data
    for ( int i = 0; i < wsize; i++ ) {
        I2C1TRN = wdata[ i ];
        while ( 1 ) {
            if ( I2C1STATbits.BCL ) return -5;
            if ( ! I2C1STATbits.TRSTAT ) break;
        }
        if ( I2C1STATbits.ACKSTAT ) return -6;
    }

    if ( hasRead ) {
        // if we've been writing, send a Repeated Start
        if ( hasWrite ) {
            // generate start condition
            I2C1CONbits.RSEN = 1;
            while ( 1 ) {
                if ( I2C1STATbits.BCL ) return -7;
                if ( ! I2C1CONbits.RSEN ) break;
            }

            // Send 7-bit slave address with Read flag
            I2C1TRN = ( address << 1 ) | 0x01;
            while ( 1 ) {
                if ( I2C1STATbits.BCL ) return -8;
                if ( ! I2C1STATbits.TRSTAT ) break;
            }
            if ( I2C1STATbits.ACKSTAT ) return -9;
        }

        // Read data
        for ( int i = 0; i < rsize; i++ ) {
            // check idle
            if ( I2C1CON & 0x1F ) return -10;

            // enable reception
            I2C1CONbits.RCEN = 1;
            while ( 1 ) {
                if ( I2C1STATbits.BCL ) return -11;
                if ( ! I2C1CONbits.RCEN ) break;
            }

            // read data byte from buffer
            rdata[ i ] = I2C1RCV;
            count++;

            // send acknowledge (or not acknowledge for final byte)
            I2C1CONbits.ACKDT = i == ( rsize - 1 ) ? 1 : 0;
            I2C1CONbits.ACKEN = 1;
            while ( 1 ) {
                if ( I2C1STATbits.BCL ) return -12;
                if ( ! I2C1CONbits.ACKEN ) break;
            }
        }
    }

    // Generate stop condition
    I2C1CONbits.PEN = 1;
    while ( 1 ) {
        if ( I2C1STATbits.BCL ) return -13;
        if ( ! I2C1CONbits.PEN ) break;
    }

    return count;
}


int16_t i2c1Xfer(
	uint8_t address,
	uint8_t* wdata, int wsize,
	uint8_t* rdata, int rsize )
{
    int16_t result = i2c1XferInt( address, wdata, wsize, rdata, rsize );
    if ( result < 0 ) {
        // clear bus collision
        I2C1STATbits.BCL = 0;
        // clear start condition
        if ( I2C1STATbits.S )
            I2C1CONbits.PEN = 1;
    }
    return result;
}


void i2c1Reset()
{
    // first make sure I2C module is disabled
    i2c1Disable();

    // hold SCL low for 100 ms to reset I2C bus
    I2C1_SCL_TRIS = 0;
    I2C1_SCL_LAT = 0;
    for ( int i = 0; i < 10; i++ )
        __delay_ms( 10 );
    // tri-date SCL and SDA
    I2C1_SCL_TRIS = 1;
    I2C1_SDA_TRIS = 1;
    __delay_ms( 10 );
}


/////////////////////////////////////////////////////////////////////////
//
// SSD1308 OLED Routines
//

#define SSD1308_Address                 0x3c
#define SSD1308_Command_Mode		0x80
#define SSD1308_Data_Mode               0x40
#define SSD1308_Display_Off_Cmd         0xAE
#define SSD1308_Display_On_Cmd          0xAF
#define SSD1308_Normal_Display_Cmd      0xA6
#define SSD1308_Inverse_Display_Cmd	0xA7
#define SSD1308_Activate_Scroll_Cmd	0x2F
#define SSD1308_Dectivate_Scroll_Cmd	0x2E
#define SSD1308_Set_Brightness_Cmd      0x81


const uint8_t OledFont[][8] =
{
  {0x00,0x00,0x00,0x00,0x00,0x00,0x00,0x00},
  {0x00,0x00,0x5F,0x00,0x00,0x00,0x00,0x00},
  {0x00,0x00,0x07,0x00,0x07,0x00,0x00,0x00},
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  {0x00,0x02,0x05,0x05,0x02,0x00,0x00,0x00}
};


void oledCommand( uint8_t ch )
{
    uint8_t bytes[2];
    bytes[0] = SSD1308_Command_Mode;
    bytes[1] = ch;
    i2c1Xfer( SSD1308_Address, bytes, 2, NULL, 0 );
}


void oledDisplayOffset( uint8_t offset )
{
    uint8_t bytes[3];
    bytes[0] = SSD1308_Command_Mode;
    bytes[1] = 0xD3;
    bytes[2] = offset;
    i2c1Xfer( SSD1308_Address, bytes, 3, NULL, 0 );
}


void oledData( uint8_t data )
{
    uint8_t bytes[2];
    bytes[0] = SSD1308_Data_Mode;
    bytes[1] = data;
    i2c1Xfer( SSD1308_Address, bytes, 2, NULL, 0 );
}


void oledGotoYX(unsigned char Row, unsigned char Column)
{
    oledCommand( 0xB0 + Row);
    oledCommand( 0x00 + (8*Column & 0x0F) );
    oledCommand( 0x10 + ((8*Column>>4)&0x0F) );
}


void oledPutChar( char ch )
{
    if ( ( ch < 32 ) || ( ch > 127 ) )
        ch = ' ';

    const uint8_t *base = &OledFont[ch - 32][0];

    uint8_t bytes[9];
    bytes[0] = SSD1308_Data_Mode;
    memmove( bytes + 1, base, 8 );
    i2c1Xfer( SSD1308_Address, bytes, 9, NULL, 0 );
}


void oledPrint( char *s )
{
    while (*s) oledPutChar( *s++);
}


void oledClear()
{
    for ( uint16_t row = 0; row < 8; row++ ) {
        for ( uint16_t col = 0; col < 16; col++ ) {
            oledGotoYX( row, col );
            oledPutChar( ' ' );
        }
    }
}


void oledInit()
{
    oledCommand( SSD1308_Display_Off_Cmd );
    __delay_ms( 100 );
    oledCommand( SSD1308_Display_On_Cmd );
    __delay_ms( 100 );
    oledCommand( SSD1308_Normal_Display_Cmd );
    oledCommand( SSD1308_Dectivate_Scroll_Cmd );
}


/////////////////////////////////////////////////////////////////////////
//
// Main
//


static void setupOscillator()
{
    // Configure Internal FRC for 8MHz
    CLKDIVbits.RCDIV = 0b000; // divide-by-1 = 8MHz

    // Initiate Clock Switch to Internal FRCPLL (NOSC = 0b001)
    __builtin_write_OSCCONH( 0x01 );
    __builtin_write_OSCCONL( OSCCON | 0x01 );
    // Wait for Clock switch to occur
    while ( OSCCONbits.COSC != 0b001 );
    // Wait for PLL to lock
    while ( OSCCONbits.LOCK != 1 );
}


int main( int argc, char** argv )
{
    setupOscillator();

    ANSA = 0;
    ANSB = 0;

    __delay_ms( 2000 );

    i2c1Reset();
    i2c1Enable( kI2C_400KHZ );

    oledInit();
    oledClear();

    oledGotoYX( 0, 0 );
    oledPrint( "OLED SSD1308" );

    uint16_t count = 0;
    while ( 1 ) {
        char s[20];
        itoa( s, count, 10 );
        oledGotoYX( 2, 0 );
        oledPrint( s );
        oledPrint( "     " );
        __delay_ms( 100 );
        count++;
    }
}

